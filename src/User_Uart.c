/******************************************************************************
文件名称: Uart.c
文件标识: STC8A8K64S4A12
摘    要: Uart硬件操作函数
当前版本: V1.0	
完成日期: 2021.02.12
*******************************************************************************/
#define	USER_UART_GLOBALS
#include "include.h"
#include "wifi.h"

char wptr,wptr4;
char rptr,rptr4;
char buffer[16],buffer4[16];
bit busy;
/*****************************************************************************
函数名称 : Uart1Init
功能描述 : uart1初始化
输入参数 : 无
返回参数 : 无
使用说明 : 无
*****************************************************************************/

void Uart1Init()	// 9600bps@11.059200MHz
{
	SCON  = 0x50;		// 8位数据,可变波特率
	AUXR |= 0x40;		// 定时器1时钟为Fosc,即1T
	AUXR &= 0xFE;		// 串口1选择定时器1为波特率发生器
	TMOD &= 0x0F;		// 设定定时器1为16位自动重装方式
    TL1= BRT;
    TH1= BRT >> 8;
	ET1   = 0;		    // 禁止定时器1中断
	TR1   = 1;		    // 启动定时器1
	ES    = 1;          // 开串口中断
	EA    = 1;          // 开总中断
}
/*****************************************************************************
函数名称 : Uart1_PutChar
功能描述 : 串口发送一个字节
输入参数 : dat:待发送数据
返回参数 : 无
使用说明 : 无
*****************************************************************************/
void Uart1_PutChar(char dat)
{
    while (busy);  // 当busy=0时，跳出循环，表示可以发送数据了
    busy = 1;      // 发送标志置1，为下次发送做准备
    SBUF = dat;    // 开始发送字节   (SXBUF = SBUF、S2BUF、S3BUF、S4BUF)
}
/*****************************************************************************
函数名称 : Uart1SendStr
功能描述 : 串口发送一个字符串
输入参数 : p:字符串指针
返回参数 : 无
使用说明 : 无
*****************************************************************************/
void Uart1SendStr(char *p)
{
    while (*p)
    {
        Uart1_PutChar(*p++);
    }
}
/*****************************************************************************
函数名称 : UART1_Isr
功能描述 : Uart1串口中断处理函数
输入参数 : 无
返回参数 : 无
使用说明 : 无
*****************************************************************************/
void UART1_Isr() interrupt 4
{
    if (TI)                   // 发送中断标志位判断
    {
        TI = 0;               // 清中断标志
		busy = 0;             // 发送标志位置0，表示满足发送条件
        LEDT1=~LEDT1;         // 测试端口
    }
    if (RI)                   // 接收中断标志位判断
    {
        RI = 0;               // 清中断标志
        LEDR1=~LEDR1;         // 测试端口
		//buffer[wptr++] = SBUF;
		//wptr &= 0x0f;
        uart_receive_input(SBUF);
    }
}
/*****************************************************************************
函数名称 : Uart4Init
功能描述 : uart4初始化
输入参数 : 无
返回参数 : 无
使用说明 : 无
*****************************************************************************/

void Uart4Init()	
{
    P_SW2 |= 0x04;      //选择串口4的第二组P5.2R P5.3T
    P5M0 = 0x08;
    P5M1 = 0x00;
	S4CON  = 0x10;		// 8位数据,可变波特率
	S4CON &= 0xBF;		// 串口4选择定时器2为波特率发生器
	AUXR  |= 0x04;		// 定时器2时钟为Fosc,即1T
	T2L    = BRT;		// 65536-12000000/9600/4=FEC7H
	T2H    = BRT >> 8;	// 设定定时初值
	AUXR  |= 0x10;		// 启动定时器2
	IE2    = ES4;       // 使能串口中断
	EA     = 1;         // 开总中断
}
/*****************************************************************************
函数名称 : Uart4_PutChar
功能描述 : 串口发送一个字节
输入参数 : dat:待发送数据
返回参数 : 无
使用说明 : 无
*****************************************************************************/
void Uart4_PutChar(char dat)
{
    while (busy);  // 当busy=0时，跳出循环，表示可以发送数据了
    busy = 1;      // 发送标志置1，为下次发送做准备
    S4BUF = dat;    // 开始发送字节   (SXBUF = SBUF、S2BUF、S3BUF、S4BUF)
}
/*****************************************************************************
函数名称 : UART4_Isr
功能描述 : Uart4串口中断处理函数
输入参数 : 无
返回参数 : 无
使用说明 : 无
*****************************************************************************/
void UART4_Isr() interrupt 18
{
    if (S4CON & S4TI)           // 发送中断标志判断
    {
        S4CON &= ~S4TI;         // 清中断标志
        LEDT1=~LEDT1;           // 测试端口
		busy = 0;
    }
    if (S4CON & S4RI)           // 接收中断标志判断
    {
        S4CON &= ~S4RI;         // 清中断标志
        LEDR1=~LEDR1;           // 测试端口
		//buffer4[wptr4++] = S4BUF; // 接收数据
		//wptr4 &= 0x0f;           // 确保接收数据不超出数组长度
        uart_receive_input(S4BUF);
    }
}
